## examples/05-wifi-mdns-color-picker/sdkconfig.defaults
```kconfig
CONFIG_IDF_TARGET="esp32s3"
CONFIG_LWIP_MAX_SOCKETS=16
CONFIG_HTTPD_WS_SUPPORT=y

# mDNS 配置：使用 socket 网络模式（比 lwIP PCB 模式在 APSTA 场景下更稳定）
CONFIG_MDNS_NETWORKING_SOCKET=y
# 仅在 STA 接口上启用 mDNS（AP 接口不需要）
CONFIG_MDNS_PREDEF_NETIF_AP=n
# 开启 debug 日志便于排查问题
CONFIG_MDNS_ENABLE_DEBUG_PRINTS=y
CONFIG_MDNS_RESPOND_REVERSE_QUERIES=y
```
